## arch/arm64/configs/hawaiip_defconfig
```kconfig
# Moto G22 (hawaiip) Kernel Configuration
CONFIG_LOCALVERSION="-MrKernel-X.X.X"
CONFIG_ARCH_MEDIATEK=y
CONFIG_MTK_PLATFORM="mt6765"
CONFIG_MACH_MT6765=y

# CPU Configuration
CONFIG_ARM64=y
CONFIG_64BIT=y
CONFIG_SMP=y
CONFIG_NR_CPUS=8
CONFIG_ARM64_DMA_USE_IOMMU=y

# GPU Configuration
CONFIG_MTK_GPU_SUPPORT=y
CONFIG_MTK_GPU_VERSION="mali-g37"
CONFIG_MTK_GPU_COMMON_DVFS_SUPPORT=y

# Power Management
CONFIG_CPU_FREQ=y
CONFIG_CPU_FREQ_DEFAULT_GOV_INTERACTIVE=y
CONFIG_CPU_FREQ_GOV_PERFORMANCE=y
CONFIG_CPU_FREQ_GOV_POWERSAVE=y
CONFIG_CPU_FREQ_GOV_USERSPACE=y
CONFIG_CPU_FREQ_GOV_ONDEMAND=y
CONFIG_CPU_FREQ_GOV_CONSERVATIVE=y

# Thermal Management
CONFIG_THERMAL=y
CONFIG_MTK_THERMAL_PA_VIA_ATCMD=y
CONFIG_MTK_PUMP_EXPRESS_PLUS_SUPPORT=y

# Memory Management
CONFIG_ZRAM=y
CONFIG_ZRAM_WRITEBACK=y
CONFIG_SWAP=y
CONFIG_MEMCG=y
CONFIG_MEMCG_SWAP=y

# I/O Schedulers
CONFIG_IOSCHED_BFQ=y
CONFIG_DEFAULT_BFQ=y
CONFIG_DEFAULT_IOSCHED="bfq"

# Camera
CONFIG_MTK_CAMERA_ISP=y
CONFIG_MTK_CAMERA_ISP_SUPPORT=y
CONFIG_MTK_IMGSENSOR=y

# Touch Screen
CONFIG_TOUCHSCREEN_MTK=y
CONFIG_TOUCHSCREEN_MTK_TOUCH="GT9XX"

# Audio
CONFIG_SND_SOC_MTK=y
CONFIG_SND_SOC_MTK_SMART_PHONE=y
CONFIG_MTK_SND_SOC_NEW_ARCH=y

# Networking
CONFIG_WLAN=y
CONFIG_MTK_WLAN=y
CONFIG_MTK_WLAN_SUPPORT=y 
```
